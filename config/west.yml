## config/west.yml
```yaml
manifest:
  remotes:
    - name: zmkfirmware
      url-base: https://github.com
  projects:
    - name: zmk
      remote: zmkfirmware
      revision: main  # A revisão deve ficar aqui dentro do projeto 'zmk'
      import: app/west.yml
  self:
    path: config
```
